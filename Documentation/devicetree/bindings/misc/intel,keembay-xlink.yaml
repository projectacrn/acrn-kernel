## Documentation/devicetree/bindings/misc/intel,keembay-xlink.yaml
```yaml
# SPDX-License-Identifier: (GPL-2.0 OR BSD-2-Clause)
# Copyright (c) Intel Corporation. All rights reserved.
%YAML 1.2
---
$id: "http://devicetree.org/schemas/misc/intel,keembay-xlink.yaml#"
$schema: "http://devicetree.org/meta-schemas/core.yaml#"

title: Intel Keem Bay xlink

maintainers:
  - Seamus Kelly <seamus.kelly@intel.com>

description: |
  The Keem Bay xlink driver enables the communication/control sub-system
  for internal and external communications to the Intel Keem Bay SoC.

properties:
  compatible:
    oneOf:
      - items:
        - const: intel,keembay-xlink

examples:
  - |
    xlink {
        compatible = "intel,keembay-xlink";
    };
```

## drivers/gpu/drm/hantro_driver/Kconfig
```kconfig
config DRM_HANTRO
	tristate "Hantro Driver"
	depends on DRM
	default m
	select DRM_PANEL
	select DRM_KMS_HELPER
	help
	  Choose this option if your system supports Hantro Driver
	  for KMB ARM Media. This driver supports video and JPEG
	  encode/decode.
```

## drivers/misc/xlink-core/Kconfig
```kconfig
config XLINK_CORE
	tristate "Support for XLINK CORE"
	depends on (XLINK_PCIE_LH_DRIVER || XLINK_PCIE_RH_DRIVER || XBAY_XLINK_PCIE_LH_DRIVER || XBAY_XLINK_PCIE_RH_DRIVER)
	help
	  XLINK CORE enables the communication/control Sub-System.

	  If unsure, say N.

	  To compile this driver as a module, choose M here: the
	  module will be called xlink.ko.

config XLINK_LOCAL_HOST
	tristate "Support for XLINK LOCAL HOST"
	depends on XLINK_CORE && XLINK_IPC
	help
	  XLINK LOCAL HOST enables local host functionality for
	  the communication/control Sub-System.

	  Enable this config when building the kernel for the VPU Local Host core.

	  If building for a Remote Host kernel, say N.



config XLINK_PSS
	tristate "Support for XLINK PSS"
	depends on XLINK_LOCAL_HOST
	help
	  XLINK PSS enables the communication/control Sub-System on a PSS platform.

	  Enable this config when building the kernel for the VPU in a simulated env.

	  If building for a VPU silicon, say N.
```

## drivers/platform/x86/socperf/Kconfig
```kconfig
config INTEL_SOCPERF
	depends on X86
	tristate "Intel SocPerf driver"
	help
	  Say Y here to enable SoCPerf driver
```

## drivers/platform/x86/socwatch/Kconfig
```kconfig
menuconfig INTEL_SOCWATCH
	depends on X86
	tristate "SocWatch Driver Support"
	help
	  Say Y here to enable SocWatch

config SOCWATCH_ANDROID
	depends on INTEL_SOCWATCH
	bool "Android support"
	help
	  Say Y here to enable SocWatch support for Android

config SOCWATCH_SOCPERF
	depends on INTEL_SOCWATCH && INTEL_SOCPERF
	bool "SocPerf Support"
	help
	  Say Y here to enable SocWatch SocPerf support

config SOCWATCH_DRIVER_PROFILING
	depends on INTEL_SOCWATCH
	bool "Driver Profiling Support"
	help
	  Say Y here to enable SocWatch driver profiling
```

## drivers/soc/keembay/Kconfig
```kconfig
# SPDX-License-Identifier: GPL-2.0-only
#
# Keem Bay SoC drivers
#

menu "Keem Bay SoC drivers"

config KEEMBAY_IPC
	tristate "Support for Keem Bay IPC"
	depends on ARM64
	help
	  Keem Bay IPC enables communication between the Keem Bay CPU
	  Sub-System (CSS) and the Keem Bay Media Sub-System (MSS).

	  Select this if you are compiling the Kernel for the Intel Movidius
	  SoC code named Keem Bay.

endmenu
```

## drivers/usb/typec/mux/Kconfig
```kconfig
menu "USB Type-C Multiplexer/DeMultiplexer Switch support"

config TYPEC_MUX_PI3USB30532
	tristate "Pericom PI3USB30532 Type-C cross switch driver"
	depends on I2C
	help
	  Say Y or M if your system has a Pericom PI3USB30532 Type-C cross
	  switch / mux chip found on some devices with a Type-C port.


config TYPEC_MUX_INTEL_PMC
	tristate "Intel PMC mux control"
	depends on INTEL_PMC_IPC
	help
	  Driver for USB muxes controlled by Intel PMC FW.

endmenu
```
